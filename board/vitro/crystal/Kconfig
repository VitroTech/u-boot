## board/vitro/crystal/Kconfig
```kconfig
if TARGET_CRYSTAL

config IMX_CONFIG
       default "arch/arm/mach-imx/spl_sd.cfg"

config SYS_BOARD
	default "crystal"

config SYS_VENDOR
	default "vitro"

config SYS_CONFIG_NAME
	default "crystal"

endif
```
